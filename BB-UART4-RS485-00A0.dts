/dts-v1/;
/plugin/;

/ {
	compatible = "ti,beaglebone", "ti,beaglebone-black", "ti,beaglebone-green";
	part-number = "BB-UART4-RS485";
	version = "00A0";
	exclusive-use = "P9.13", "P9.11", "P8.33", "gpio1_9", "uart5";

	fragment@0 {
		target = <&am33xx_pinmux>;

		__overlay__ {
			bb_uart5_rs485_pins: pinmux_bb_uart5_rs485_pins {
				pinctrl-single,pins = <0x74 0x6 0x70 0x26 0x0D4 0x6>;
			};
		};
	};

	fragment@1 {
		target = <&uart5>;

		__overlay__ {
			status = "okay";
			pinctrl-names = "default";
			pinctrl-0 = <&bb_uart5_rs485_pins>;
			rs485-rts-delay = <0 0>;
			rts-gpio = <&gpio1 9 0>;
			rs485-rts-active-low;
			linux,rs485-enabled-at-boot-time;
		};
	};

};
